## Kconfig
```kconfig
# Copyright (c) 2026, Centro de Inovação Edge.
# SPDX-License-Identifier: BSD-3-Clause

menuconfig OLED_DISPLAY
    bool "OLED SH1106 Display"
    default n

if OLED_DISPLAY

choice
prompt "Display Hardware Communication"
default OLED_DISPLAY_SPI
    config OLED_DISPLAY_I2C
        bool "OLED SH1106 Display over I2C"
        default n
        depends on I2C

    config OLED_DISPLAY_SPI
        bool "Real OLED over SPI."
        depends on SPI

    config DISPLAY_VIRTUAL
        bool "Virtual OLED over RTT."
        depends on CONSOLE
        depends on RTT_CONSOLE
        depends on USE_SEGGER_RTT   
endchoice

config DISPLAY_MAX_FPS
    int "Display maximum frame rate, in FPS."
    default 24
    range 12 24

config INACTIVE_THRESHOLD_MINS
    depends on OLED_DISPLAY_SPI || OLED_DISPLAY_I2C
    int "Display maximum inactive time, in minutes."
    default 5

config VIRTUAL_DISPLAY_MARKER_STR
    depends on DISPLAY_VIRTUAL
    string "Screen buffer marker string."
    default "#!D-VRAM#!"

config DISPLAY_I2C_CTRL_CMD
    hex "I2C control command byte."
    default 0x00
    range 0x00 0xFF
    depends on OLED_DISPLAY_I2C

config DISPLAY_I2C_CTRL_DATA
    hex "I2C control data byte."
    default 0x40
    range 0x00 0xFF
    depends on OLED_DISPLAY_I2C

config DISPLAY_I2C_MAX_PAYLOAD
    int "I2C maximum payload size."
    default 128
    range 1 255
    depends on OLED_DISPLAY_I2C

endif # OLED_DISPLAY
```
